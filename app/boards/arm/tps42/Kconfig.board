## app/boards/arm/tps42/Kconfig.board
```kconfig
# TPS42 board configuration

# Copyright (c) 2021 Christoph Rehmann
# SPDX-License-Identifier: MIT

config BOARD_TPS42_LEFT
	bool "tps42_left"
	depends on SOC_NRF52840_QIAA

config BOARD_TPS42_RIGHT
	bool "tps42_right"
	depends on SOC_NRF52840_QIAA 
```

## app/boards/arm/tps42/Kconfig.defconfig
```kconfig
# Copyright (c) 2021 Christoph Rehmann
# SPDX-License-Identifier: MIT

if BOARD_TPS42_LEFT

	config ZMK_KEYBOARD_NAME
	default "TPS42 (L)"

endif # BOARD_TPS42_LEFT

if BOARD_TPS42_RIGHT

	config ZMK_KEYBOARD_NAME
	default "TPS42"

	config ZMK_SPLIT_BLE_ROLE_CENTRAL
    default y

endif # BOARD_TPS42_RIGHT


if BOARD_TPS42_LEFT || BOARD_TPS42_RIGHT

config BOARD
	default "tps42"

config ZMK_SPLIT
	default y

menuconfig SENSOR
    bool "Sensor Drivers"

config BT_CTLR
	default BT

config ZMK_BLE
	default y

config ZMK_USB
	default y

config ZMK_BATTERY_VOLTAGE_DIVIDER
	default y

if USB

config USB_NRFX
	default y

config USB_DEVICE_STACK
	default y

endif # USB

endif # BOARD_TPS42_LEFT || BOARD_TPS42_RIGHT 
```

## app/boards/arm/tps42/tps42_right_defconfig
```kconfig
# SPDX-License-Identifier: MIT

CONFIG_SOC_SERIES_NRF52X=y
CONFIG_SOC_NRF52840_QIAA=y
CONFIG_BOARD_TPS42_RIGHT=y
CONFIG_ZMK_SPLIT=y
CONFIG_ZMK_SPLIT_BLE_ROLE_CENTRAL=y
CONFIG_ZMK_SLEEP=y

# Enable MPU
CONFIG_ARM_MPU=y

# enable GPIO
CONFIG_GPIO=y

# Enable writing to flash
CONFIG_USE_DT_CODE_PARTITION=y
CONFIG_MPU_ALLOW_FLASH_WRITE=y
CONFIG_NVS=y
CONFIG_SETTINGS_NVS=y
CONFIG_FLASH=y
CONFIG_FLASH_PAGE_LAYOUT=y
CONFIG_FLASH_MAP=y

# Enable external crystal
CONFIG_CLOCK_CONTROL_NRF_K32SRC_XTAL=y
CONFIG_CLOCK_CONTROL_NRF_K32SRC_30PPM=y

# # Turn on logging, and set ZMK logging to debug output
CONFIG_ZMK_USB_LOGGING=y

# # Turn on logging, and set ZMK logging to debug output
CONFIG_LOG=y
CONFIG_ZMK_LOG_LEVEL_DBG=y

# Dispay
CONFIG_ZMK_DISPLAY=y
CONFIG_LVGL_HOR_RES_MAX=80
CONFIG_LVGL_VER_RES_MAX=128
CONFIG_SPI=y
CONFIG_IL0323=y
CONFIG_SSD1306=n
CONFIG_LVGL_BITS_PER_PIXEL=1
CONFIG_LVGL_COLOR_DEPTH_1=y
CONFIG_LVGL_DPI=130
CONFIG_LVGL_VDB_SIZE=16
```

## app/boards/shields/besom/Kconfig.defconfig
```kconfig
# Copyright (c) 2020 The ZMK Contributors
# SPDX-License-Identifier: MIT
 
if SHIELD_BESOM_LEFT

config ZMK_KEYBOARD_NAME
    default "Besom Left"

config ZMK_SPLIT_BLE_ROLE_CENTRAL
    default y

endif

if SHIELD_BESOM_RIGHT

config ZMK_KEYBOARD_NAME
    default "Besom Right"

endif

if SHIELD_BESOM_LEFT || SHIELD_BESOM_RIGHT

config ZMK_SPLIT
    default y

endif
```
